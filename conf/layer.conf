## conf/layer.conf
```bitbake
# We have a conf and classes directory, add to BBPATH
BBPATH .= ":${LAYERDIR}"

# We have recipes-* directories, add to BBFILES
BBFILES += "${LAYERDIR}/recipes-*/*/*.bb \
            ${LAYERDIR}/recipes-*/*/*.bbappend"

BBFILE_COLLECTIONS += "meta-hamouda"
BBFILE_PATTERN_meta-hamouda = "^${LAYERDIR}/"
BBFILE_PRIORITY_meta-hamouda = "6"

LAYERDEPENDS_meta-hamouda = "core"
LAYERSERIES_COMPAT_meta-hamouda = "scarthgap"
```
